

#include <avr/io.h>
#include <util/delay.h>
#include <avr/interrupt.h>
#include <stdio.h>
#include <avr/eeprom.h>
#include "pins.h"

#define F_CPU 16000000UL

uint8_t  sine[256] = {
  0x80, 0x83, 0x86, 0x89, 0x8C, 0x90, 0x93, 0x96,
  0x99, 0x9C, 0x9F, 0xA2, 0xA5, 0xA8, 0xAB, 0xAE,
  0xB1, 0xB3, 0xB6, 0xB9, 0xBC, 0xBF, 0xC1, 0xC4,
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  0x67, 0x6A, 0x6D, 0x70, 0x74, 0x77, 0x7A, 0x7D
};

volatile uint8_t sineIndex = 0;

volatile __uint24 x_axis_phaseRegister = 0;
volatile __uint24 y_axis_phaseRegister = 0;
volatile __uint24 x_axis_inc = 500UL;
volatile __uint24 y_axis_inc = 500UL;

#define TIMER_IRQ_FREQ 500000 //this value must be adjusted to match the IRQ frequency
typedef struct {
  char axis;
  uint32_t no_of_steps;
  uint32_t is_steps;
  uint32_t ist_pos_scale;
  uint32_t speed_ticks;
} t_movement;

t_movement x_movement;
t_movement y_movement;

int setup_fgen(void) {

    // Setup DAC port
    DRIVER_PORT = 0xFF; // All pins are outputs
    PORTD = 0x00; // Clear it.

    // Setup the 16bit timer/counter1
    // CTC mode. Top value in ICR1 - WGM13:0 = 12
    TCCR1B |= (1 << WGM12) | (1 << WGM13);

    // Enable input capture interrupt
    TIMSK1 |= (1 << ICIE1);

    // Value for ICR1
    // This defines our fs = 500 kHz
    // The maximum number of cycles we're allowed to spend in the irq handler is also roughly equal with this value 
    ICR1 = 32;
    
    // Prescaler 1 & start the timer
/*CS12 CS11 CS10 Description
0 0 0 No clock source (Timer/Counter stopped).
0 0 1 clk/1 (no prescaling)
0 1 0 clk/8 (from prescaler)
0 1 1 clk/64 (from prescaler)
1 0 0 clk/256 (from prescaler)
1 0 1 clk/1024 (from prescaler)    
*/
    TCCR1B |= (1 << CS10);

    // enable interrupts
    sei();

    while(1); // Do nothing.
}

#define MAX_FREQ TIMER_IRQ_FREQ/10

void run_axis(uint32_t no_of_steps_x, uint32_t no_of_steps_y, uint32_t speed){
  x_movement.no_of_steps = no_of_steps_x;
  y_movement.no_of_steps = no_of_steps_y;
  x_movement.is_steps = 0;
  y_movement.is_steps = 0;
  uint32_t freq_x = no_of_steps_x/speed;
  uint32_t freq_y = no_of_steps_y/speed;
}

bool setFreq(char axis, uint32_t freq){
  if (freq > MAX_FREQ) return false;
  uint32_t axis_inc = freq*0xFFFFFFFF/TIMER_IRQ_FREQ;
  if (axis_inc > 0xFFFFFF){ //Should not happen if MAX_FREQ is set correctly, but if it does not fit on 24 bits, error
    return false;
  }
  if (axis == 'x'){
    x_axis_inc = axis_inc;
  }else if (axis == 'y'){
    y_axis_inc = axis_inc;
  }
}

void scale_feedback_loop (){
  uint32_t is_pos_as_steps = linear_scale_ticks*factor;
  if (is_pos_as_steps<x_movement.is_steps){
    
  }
}
// TIMER CAPTURE ISR
ISR(TIMER1_CAPT_vect) {
    //PORTB |= (1 << PB0);

    //sineIndex = (uint8_t)((uint32_t)(phaseRegister >> 24));
    //PORTD = sine[sineIndex];
    
    x_axis_phaseRegister += x_axis_inc;
    y_axis_phaseRegister += y_axis_inc;
    //the upper bit of the pase register sets the output
    //digitalWrite(PIN_STEP_X, (x_axis_phaseRegister >> 23)); 
    //digitalWrite(PIN_STEP_Y, (y_axis_phaseRegister >> 23)); 
    //PORTB &= ~(1 << PB0);
    if (x_axis_phaseRegister >> 23){
      DRIVER_PORT &= ~(1 << PIN_STEP_X);
      if (x_movement.no_of_steps == x_movement.no_of_steps){ //we reached position
        x_axis_inc = 0; //stop movement
      }
    }else{
      DRIVER_PORT |= (1 << PIN_STEP_X);
      x_movement.is_steps++;
    }
    
}